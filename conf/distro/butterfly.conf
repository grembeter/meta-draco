## conf/distro/butterfly.conf
```bitbake
# SPDX-License-Identifier: MIT
# SPDX-FileCopyrightText: Grygorii Tertychnyi

DISTRO_VERSION := "2025.07.0-custom"

MAINTAINER = "Grygorii Tertychnyi"

INIT_MANAGER ?= "systemd"

DISTRO_FEATURES = "${DISTRO_FEATURES_DEFAULT} opengl systemd usrmerge ldconfig"

DISTROOVERRIDES .= ":fly"

TCLIBCAPPEND = ""

TARGET_VENDOR = "-oe"

SDK_VENDOR = "-oesdk"
SDK_NAME = "${DISTRO}-${MACHINE}-${IMAGE_BASENAME}"
SDK_VERSION := "${DISTRO_VERSION}"

TOOLCHAIN_OUTPUTNAME = "${SDK_NAME}-${SDK_VERSION}"

PREFERRED_PROVIDER_virtual/kernel ?= "linux-butterfly"

BUTTERFLY_SYSTEM_SHELL := "dash"
ALTERNATIVE_PRIORITY:pn-${BUTTERFLY_SYSTEM_SHELL} ?= "150"

INHERIT += "insane"
INHERIT += "sanity"

DISTRO = "butterfly"
DISTRO_NAME = "ButterFly"

PREFERRED_RPROVIDER_libgstapp-1.0 ?= "gstreamer1.0-plugins-base"
```

## conf/layer.conf
```bitbake
# SPDX-License-Identifier: MIT
# SPDX-FileCopyrightText: Grygorii Tertychnyi

BBPATH =. "${LAYERDIR}:"
BBFILES += " \
  ${LAYERDIR}/recipes-*/*/*.bb \
  ${LAYERDIR}/recipes-*/*/*.bbappend \
"

BBFILE_COLLECTIONS += "butterfly"
BBFILE_PATTERN_butterfly = "^${LAYERDIR}/"

# the priority for recipes from this layer must be higher than any
# recipes from opensource layers
BBFILE_PRIORITY_butterfly = "27"

LAYERVERSION_butterfly = "1"

LAYERDEPENDS_butterfly = "core"
# meta-oe
LAYERDEPENDS_butterfly += "openembedded-layer"
# meta-networking
LAYERDEPENDS_butterfly += "networking-layer"
# meta-python
LAYERDEPENDS_butterfly += "meta-python"
# meta-perl
LAYERDEPENDS_butterfly += "perl-layer"

LAYERSERIES_COMPAT_butterfly = "scarthgap"
```
